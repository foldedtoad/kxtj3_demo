## drivers/sensor/Kconfig
```kconfig
#
# Copyright (c) 2024 Callender Consulting LLC
# SPDX-License-Identifier: Apache-2.0

#
# Sensor driver option
#
menuconfig OUT_OF_TREE_SENSOR
	bool "Out-of-Tree Sensor drivers"
	help
	  Enable OUT OF TREE Sensor drivers configuration.

if OUT_OF_TREE_SENSOR

rsource "kxtj3/Kconfig"

endif # OUT_OF_TREE_SENSOR
```

## drivers/sensor/kxtj3/Kconfig
```kconfig
# Kionix KXTJ3-1057 Three Axis Accelerometer configuration options


menuconfig KXTJ3
	bool "KXTJ3 Three Axis Accelerometer"
	default y
	depends on DT_HAS_KIONIX_KXTJ3_ENABLED
	select I2C if $(dt_compat_on_bus,$(DT_COMPAT_KIONIX_KXTJ3),i2c)
	help
	  Enable I2C-based driver for KXTJ3 triaxial accelerometer sensors.

if KXTJ3

choice KXTJ3_MODE
	prompt "Application mode"
	help
	  Specify the run-time operation mode: Data or AnyMotion.

config KXTJ3_MODE_DATA
	bool "Return accelerometer data"

config KXTJ3_MODE_ANYMODE
	bool "Indicate any motion"

endchoice

choice KXTJ3_TRIGGER_MODE
	prompt "Trigger mode"
	help
	  Specify the type of triggering to be used by the driver.

config KXTJ3_TRIGGER_NONE
	bool "No trigger"

config KXTJ3_TRIGGER_THREAD
	bool "Use kernel thread"
	depends on GPIO
	select KXTJ3_TRIGGER

endchoice

config KXTJ3_TRIGGER
	bool

endif # KXTJ3
```
